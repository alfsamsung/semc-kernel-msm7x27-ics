## drivers/mmc/core/Kconfig
```kconfig
#
# MMC core configuration
#

config MMC_UNSAFE_RESUME
	bool "Allow unsafe resume (DANGEROUS)"
	help
	  If you say Y here, the MMC layer will assume that all cards
	  stayed in their respective slots during the suspend. The
	  normal behaviour is to remove them at suspend and
	  redetecting them at resume. Breaking this assumption will
	  in most cases result in data corruption.

	  This option is usually just for embedded systems which use
	  a MMC/SD card for rootfs. Most people should say N here.

config MMC_CLKGATE
	bool "MMC host clock gating (EXPERIMENTAL)"
	depends on EXPERIMENTAL
	help
	  This will attempt to aggressively gate the clock to the MMC card.
	  This is done to save power due to gating off the logic and bus
	  noise when the MMC card is not in use. Your host driver has to
	  support handling this in order for it to be of any use.

	  If unsure, say N.

config MMC_AUTO_SUSPEND
	bool "Enable auto suspend feature"
	depends on PM && MMC_UNSAFE_RESUME && EXPERIMENTAL
	default n
	help
	  If you say Y here, it allows MMC core to provide an interface for
	  the host drivers to register a callback that the core will call if
	  the MMC bus is idle for a certain amount of time.

	  The idle timeout is run-time configurable via sysfs interface. A
	  module paramter "idle_timeout" is also provided to configure the
	  value through kernel command-line. The default value is set to 20 sec.

	  This feature is supported only for SD/MMC cards.

config MMC_EMBEDDED_SDIO
	boolean "MMC embedded SDIO device support (EXPERIMENTAL)"
	depends on EXPERIMENTAL
	help
	  If you say Y here, support will be added for embedded SDIO
	  devices which do not contain the necessary enumeration
	  support in hardware to be properly detected.

config MMC_PARANOID_SD_INIT
	bool "Enable paranoid SD card initialization (EXPERIMENTAL)"
	depends on EXPERIMENTAL
	help
	  If you say Y here, the MMC layer will be extra paranoid
	  about re-trying SD init requests. This can be a useful
	  work-around for buggy controllers and hardware. Enable
	  if you are experiencing issues with SD detection.
```

## drivers/staging/ramzswap/Kconfig
```kconfig
config RAMZSWAP
	tristate "Compressed in-memory swap device (ramzswap)"
	depends on SWAP
	select SNAPPY_COMPRESS
	select SNAPPY_DECOMPRESS
	default n
	help
	  Creates virtual block devices which can (only) be used as swap
	  disks. Pages swapped to these disks are compressed and stored in
	  memory itself.

	  Snappy compresses a bit worse (around ~2%) but much (~2x) faster
	  at least on x86-64.

	  See ramzswap.txt for more information.
	  Project home: http://compcache.googlecode.com/

config RAMZSWAP_STATS
	bool "Enable ramzswap stats"
	depends on RAMZSWAP
	default y
	help
	  Enable statistics collection for ramzswap. This adds only a minimal
	  overhead. In unsure, say Y.
```

## drivers/staging/zcache/Kconfig
```kconfig
config ZCACHE
	tristate "Dynamic compression of swap pages and clean pagecache pages"
	depends on (CLEANCACHE || FRONTSWAP) && CRYPTO
	select XVMALLOC
	default n
	help
	  Zcache doubles RAM efficiency while providing a significant
	  performance boosts on many workloads.  Zcache uses
	  compression and an in-kernel implementation of transcendent
	  memory to store clean page cache pages and swap in RAM,
	  providing a noticeable reduction in disk I/O.

choice ZCACHE_CRYPTO_COMPRESS
	prompt "crypto compression method"
	depends on ZCACHE
	default ZCACHE_CRYPTO_LZO
	help
	  Select the crypto compression method used by zcache.
	  LZO is the default. Snappy compresses a bit worse (around ~2%) but
	  much (~2x) faster, at least on x86-64.
	  (Alfs NOTE crypto_snappy is in beta stage) 
config ZCACHE_CRYPTO_LZO
	bool "LZO crypto compression"
	select CRYPTO_LZO
config ZCACHE_CRYPTO_SNAPPY
	bool "Snappy crypto compression"
	select CRYPTO_SNAPPY
endchoice
```
